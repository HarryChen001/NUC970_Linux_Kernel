## drivers/input/touchscreen/gt911/Kconfig
```kconfig
config TOUCHSCREEN_GT911
        tristate "GT911 touchscreen"
        help
          Say Y here if you have a GT911 PMIC and want to enable
          support for the built-in touchscreen.

          If unsure, say N.

          To compile this driver as a module, choose M here: the
          module will be called GT911-ts.
```

## drivers/net/usb/GobiNet/Kconfig
```kconfig
config USB_NET_GOBINET
    tristate "support quectel Gobinet Driver"
    depends on USB_USBNET
    help
        it is a driver to support QUECTEL(EC20&&EC200...) Gobinet
```
